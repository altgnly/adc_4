	LIST P=16F877A
	#INCLUDE <P16F877A.INC>
	SAYICI1 EQU 0X20
	SAYICI2 EQU 0X21
	ORG 0X000
	GOTO ANA_METOT
	ORG 0X004
	GOTO KESME_METOT

KESME_METOT
	BTFSS PIR1,ADIF
	RETFIE
	BCF PIR1,ADIF

	BANKSEL ADRESH
	MOVF ADRESH,W
	BANKSEL PORTC
	MOVWF PORTC

	BANKSEL ADRESL
	MOVF ADRESL,W
	BANKSEL PORTB
	MOVWF PORTB

	MOVF ADRESL,W
	SUBLW D'153'
	BTFSS STATUS,Z
	CALL LED_YAK
	CALL LED_SONDUR

;	CALL DONUSTURME_METOT
	BSF ADCON0,GO 
	CALL GECIKME

	RETFIE

;LED_YAK
;	BSF PORTD,0
;	CALL GECIKME
;	BSF ADCON0,GO
;	CALL GECIKME
;	RETURN

;LED_SONDUR
;	BCF PORTD,0
;	CALL GECIKME
;	BSF ADCON0,GO
;	CALL GECIKME
	RETURN

ANA_METOT
	BANKSEL TRISA
	MOVLW 0XFF
	MOVWF TRISA
	CLRF TRISB
	CLRF TRISC
	CLRF TRISD

	MOVLW B'10000000'
	MOVWF ADCON1

	BANKSEL PORTA
	MOVLW 0XFF
	MOVWF PORTA
	CLRF PORTB
	CLRF PORTC
	CLRF PORTD

	BANKSEL ADCON0
	MOVLW B'11010001'
	MOVWF ADCON0
	CALL GECIKME
	BANKSEL ADCON0

	BANKSEL PIE1
	BSF PIE1,ADIE
	BANKSEL PIE1

	BANKSEL PIR1 	
	BCF PIR1,ADIF
	BANKSEL PIR1

	BANKSEL INTCON
	MOVLW B'11000000'
	MOVWF INTCON
	BANKSEL INTCON

	BSF ADCON0,GO
	CALL GECIKME

KONTROL
	GOTO KONTROL

GECIKME
	MOVLW 0XFF
	MOVWF SAYICI1

TEKRAR1
	MOVLW 0XFF
	MOVWF SAYICI2

TEKRAR2
	DECFSZ SAYICI2,F
	GOTO TEKRAR2
	DECFSZ SAYICI1,F
	GOTO TEKRAR1
	RETURN

END